## CMakeLists.txt
```
# 브레드보드 센서 확인용 (NUCLEO-H563ZI + HSC + ABP2)
# 센서 드라이버는 이 저장소(FirmWare/Core)의 것을 그대로 가져다 씀.
cmake_minimum_required(VERSION 3.20.0)
# MQTT 비밀번호는 secrets.conf 에 따로 둠 (공유 금지)
if(EXISTS ${CMAKE_CURRENT_SOURCE_DIR}/secrets.conf)
  list(APPEND EXTRA_CONF_FILE ${CMAKE_CURRENT_SOURCE_DIR}/secrets.conf)
endif()

find_package(Zephyr REQUIRED HINTS $ENV{ZEPHYR_BASE})
project(sensor_bench)

set(FW ${CMAKE_CURRENT_SOURCE_DIR}/../../Core)
target_include_directories(app PRIVATE ${FW}/Inc)
target_sources(app PRIVATE
  src/main.c
  src/bench_net.c
  src/sdp810.c
  src/bme280.c
  src/ds18b20.c
  ${FW}/Src/hsc.c
  ${FW}/Src/abp2.c)
```

## Kconfig
```
mainmenu "브레드보드 센서 확인"

config BENCH_SAMPLE_PERIOD_MS
	int "센서 측정 주기 (ms)"
	default 1000
	range 100 60000
	help
	  HSC 와 ABP2 를 한 번씩 읽는 간격. 읽기 시작부터 다음 읽기 시작까지의 시간이라,
	  읽는 데 걸린 시간(센서 3개 · HSC 16번 평균 기준 약 52 ms)을 빼고 남은 만큼만 잠.
	  제품 펌웨어는 흐름이 있을 때 1 s, 없을 때 10 s 로 잼(설계서 결정 ①).
	  브레드보드 확인에는 1000 이 기본. 값은 prj.conf 에서 바꿈.

config BENCH_ABP2_MAX_PA
	int "ABP2 정압 만점 (Pa)"
	default 6000
	range 1000 100000
	help
	  ABP2 출력 90 % 가 이 압력임 (10 % = 0 Pa). 붙어 있는 센서 부품 번호의
	  범위와 같아야 값이 맞음: 2.5KG 면 2500, 006KG 면 6000.
	  제품 드라이버 기본값(6000)을 bench 에서만 이 값으로 덮어씀.

config BENCH_HSC_ZERO
	bool "HSC 차압 영점 보정"
	default y
	help
	  켜질 때 HSC 를 여러 번 읽은 평균을 영점으로 잡고, 이후 찍는 차압에서 뺌.
	  차압 포트 둘 다 열려 있어야(실제 차압 0) 맞는 영점이 잡힘.
	  보드의 파란 USER 버튼(B1)을 누르면 그 자리에서 다시 잡음.
	  정압(ABP2)은 영점 오차가 쓰임새에 비해 작아 제품처럼 보정 안 함.

config BENCH_HSC_ZERO_SAMPLES
	int "영점 잡을 때 읽는 횟수"
	default 32
	range 4 256
	depends on BENCH_HSC_ZERO
	help
	  20 ms 간격으로 이만큼 읽어 평균함 (32 번이면 약 0.7 초).

config BENCH_HSC_GAIN_PPM
	int "HSC 보정 기울기 (백만분율, 1000000 = 1.0)"
	default 1000000
	range 500000 1500000
	help
	  찍는 HSC 차압 = 기울기 × (읽은 값 − 켜질 때 잡은 영점) + 오프셋.
	  SDP810 을 기준으로 맞춘 값을 넣음 (migration/server/hsc_fit.py 가 계산해 줌).
	  영점은 켜질 때 · USER 버튼 때 그대로 잡히고, 이 보정은 그 뒤에 곱해짐.

config BENCH_HSC_OFFSET_MPA
	int "HSC 보정 오프셋 (mPa, 1000 = 1 Pa)"
	default 0
	range -50000 50000
	help
	  위 식의 오프셋. 영점을 잡은 상태(포트 둘 다 열림)에서 찍히는 값이 이것임.

config BENCH_HSC_OVERSAMPLE
	int "HSC 를 한 번 측정에 읽는 횟수 (평균)"
	default 16
	range 1 64
	help
	  HSC 는 눈금 한 칸이 약 0.15 Pa 라 한 번만 읽으면 ±0.3 Pa 씩 튐.
	  측정 한 번에 이만큼 읽어 평균을 찍음 (16 번이면 흔들림이 약 1/4).
	  횟수 × 간격이 측정 주기보다 짧아야 함 (16 × 2 ms = 약 40 ms < 100 ms).

config BENCH_HSC_OVERSAMPLE_GAP_MS
	int "HSC 여러 번 읽을 때 간격 (ms)"
	default 2
	range 1 20

config BENCH_HSC_SMOOTH_TAU_MS
	int "HSC 값을 부드럽게 하는 시간 (ms, 0 = 끔)"
	default 1000
	range 0 60000
	help
	  찍는 HSC 값을 이 시간만큼의 이동 평균으로 부드럽게 함. 1000 이면 잔 흔들림이
	  약 1/4 로 줄고, 작은 변화는 1초쯤 늦게 따라옴. 큰 변화는 아래 값으로 바로 따라감.

config BENCH_HSC_SMOOTH_JUMP_MPA
	int "이보다 크게 바뀌면 바로 따라감 (mPa)"
	default 600
	range 100 100000
	help
	  새 값이 지금 평균과 이만큼 넘게 다르면 잡음이 아니라 진짜 압력 변화로 보고
	  평균을 버리고 바로 그 값으로 감. 600 = 0.6 Pa (잔 흔들림의 약 5배).

config BENCH_HSC_TRACK_SDP
	bool "흐름 없을 때 HSC 0점을 SDP810 에 맞추기"
	default y
	depends on BENCH_SDP810
	help
	  SDP810 값이 ±1 Pa 안쪽(흐름 없음)이고 HSC 와 차이가 5 Pa 안쪽일 때만,
	  HSC 0점을 SDP810 값 쪽으로 천천히 끌어감. 압력이 걸린 동안에는 멈춤.
	  HSC 0점이 켜진 뒤에도 조금씩 흘러서 SDP810 과 어긋나는 것을 잡아 줌.

config BENCH_HSC_TRACK_TAU_S
	int "HSC 0점이 SDP810 을 따라가는 빠르기 (초)"
	default 20
	range 2 600
	depends on BENCH_HSC_TRACK_SDP

config BENCH_HSC_FAST_MS
	int "HSC 만 더 자주 읽는 간격 (ms, 0 = 끔)"
	default 100
	range 0 1000
	help
	  측정 줄 사이에 HSC 를 이 간격으로 더 읽음 (100 ms, 1초 주기면 10개).
	  측정 줄의 HSC 값은 그 10개의 평균이고, 10개 값 하나하나는 측정 줄 바로 뒤
	  "[hsc 100 ms] #번호  v1 v2 ... v10" 줄로 같이 보냄 (못 읽은 칸은 x).
	  수집기는 이 줄을 시간별 _hsc.csv 에 1초마다 10줄로 한꺼번에 씀.
	  한 줄에 최대 20개라, 측정 주기가 길면 앞 20개만 보냄.
	  0 이면 예전처럼 측정 때 한 번만 읽고 이 줄도 안 보냄.

config BENCH_SDP810
	bool "SDP810 차압 센서도 읽기 (I2C1, 0x25)"
	default y
	help
	  HSC 와 같은 I2C1 버스에 붙은 SDP810-500Pa 를 HSC · ABP2 다음에 읽어
	  측정 줄 끝에 "  |  SDP810 ..." 으로 붙임. 안 붙어 있으면 "응답 없음" 으로
	  찍고 5초마다 다시 찾음. HSC 읽기에는 영향 없음.

config BENCH_BME280
	bool "BME280 대기압 센서도 읽기 (I2C4, 0x76)"
	default y
	help
	  정압 센서(ABP2)와 같은 I2C4 버스에 붙은 BME280 을 읽어 측정 줄 끝에
	  "  |  BME280 정상 102039.6 Pa 23.92 C 21.5 %" (대기압 · 주변 온도 · 습도)로 붙임.
	  ABP2 는 대기압 기준 압력이라, 밀도 계산의 절대압 = 이 대기압 + ABP2 정압.
	  안 붙어 있으면 "응답 없음" 으로 찍고 5초마다 다시 찾음. BMP280(습도 없음)도 됨.

config BENCH_DS18B20
	bool "DS18B20 가스 온도 센서도 읽기 (1-Wire, D2 = PG14)"
	default y
	help
	  관 속에 넣는 DS18B20 을 읽어 측정 줄 끝에 "  |  DS18B20 정상 24.31 C" 로 붙임.
	  데이터 선은 아두이노 D2 (PG14), 풀업 4.7 kΩ 는 어댑터 보드에 있음. 센서는 하나만.
	  안 붙어 있으면 "응답 없음" 으로 찍고 5초마다 다시 찾음.

config BENCH_SLOW_PERIOD_MS
	int "BME280 · DS18B20 을 읽는 간격 (ms)"
	default 1000
	range 800 60000
	help
	  둘 다 천천히 바뀌는 값이고 읽는 데 7 ~ 9 ms 씩 걸려서 측정 줄마다 읽지 않음.
	  이 간격으로 읽고, 그 사이 측정 줄에는 마지막 값을 다시 붙임.
	  DS18B20 변환이 최대 750 ms 라 800 보다 짧게는 못 함.

config BENCH_MQTT
	bool "이더넷 MQTT 로 측정 줄 보내기"
	default y
	help
	  랜선(보드 RJ45)으로 DHCP 주소를 받고, 시리얼에 찍는 줄과 같은 글을
	  MQTT 브로커로 보냄. 시리얼 출력은 그대로 나옴. 네트워크 설정은 prj.conf.

if BENCH_MQTT

config BENCH_MQTT_BROKER
	string "MQTT 브로커 IPv4 주소"
	default "172.30.1.1"
	help
	  PC 의 Mosquitto. PC 주소가 바뀌면 여기를 바꿔 다시 빌드.

config BENCH_MQTT_PORT
	int "MQTT 브로커 포트"
	default 1883

config BENCH_MQTT_USER
	string "MQTT 사용자"
	default "h563"

config BENCH_MQTT_PASSWORD
	string "MQTT 비밀번호 (secrets.conf 에서 넣음)"
	default ""

config BENCH_MQTT_CLIENT_ID
	string "MQTT 클라이언트 ID"
	default "h563-bench"

config BENCH_MQTT_TOPIC
	string "토픽 앞부분 (뒤에 /line, /status 가 붙음)"
	default "h563/bench"

config BENCH_MQTT_QUEUE
	int "끊긴 동안 쌓아 둘 줄 수"
	default 300
	range 10 1000
	help
	  한 줄 320 바이트. 300 줄이면 1초 주기에 5분, 0.1초 주기에 30초.

endif

source "Kconfig.zephyr"
```

## prj.conf
```kconfig
CONFIG_I2C=y
CONFIG_PRINTK=y
CONFIG_CBPRINTF_FP_SUPPORT=y
CONFIG_MAIN_STACK_SIZE=6144
# 손으로 버스를 볼 수 있게 (i2c scan i2c@40005400 / i2c@40005800)
CONFIG_SHELL=y
CONFIG_I2C_SHELL=y
CONFIG_GPIO=y
# 센서 측정 주기 (ms). 100–60000. 바꾸면 다시 빌드 · 굽기. 페이지와 MCP 서버는 로그에서 이 값을 읽어 자동으로 맞춤.
CONFIG_BENCH_SAMPLE_PERIOD_MS=100
# HSC 차압 영점 보정 (켜질 때 자동, 파란 USER 버튼으로 다시). 끄려면 n.
CONFIG_BENCH_HSC_ZERO=y
# ABP2 정압 만점 (Pa). 붙은 센서 부품 범위와 같아야 함: 2.5KG=2500, 006KG=6000.
CONFIG_BENCH_ABP2_MAX_PA=6000

# ---- 이더넷 + MQTT (CONFIG_BENCH_MQTT, 브로커 주소는 Kconfig / 비밀번호는 secrets.conf) ----
CONFIG_NETWORKING=y
CONFIG_NET_IPV4=y
CONFIG_NET_IPV6=n
CONFIG_NET_TCP=y
CONFIG_NET_UDP=y
CONFIG_NET_SOCKETS=y
CONFIG_NET_L2_ETHERNET=y
CONFIG_NET_DHCPV4=y
CONFIG_NET_MGMT=y
CONFIG_NET_MGMT_EVENT=y
CONFIG_NET_MGMT_EVENT_INFO=y
CONFIG_ENTROPY_GENERATOR=y
CONFIG_NET_PKT_RX_COUNT=16
CONFIG_NET_PKT_TX_COUNT=16
CONFIG_NET_BUF_RX_COUNT=64
CONFIG_NET_BUF_TX_COUNT=64
CONFIG_MQTT_LIB=y
CONFIG_MQTT_KEEPALIVE=60
CONFIG_NET_SHELL=y

# ---- 서버(브로커) 주소. 서버를 옮기면 여기를 새 PC(맥) 주소로 바꾸고 다시 빌드 · 굽기 ----
CONFIG_BENCH_MQTT_BROKER="172.30.1.93"
# HSC 만 따로 더 자주 읽기 (0 = 끔). 주기가 이미 100 ms 라 끔
CONFIG_BENCH_HSC_FAST_MS=0
```

## boards/nucleo_h563zi.overlay
```dts
/* 브레드보드 배선
 *   HSC  → I2C1: PB8 SCL (CN7-2),   PB9 SDA (CN7-4)   — 보드 기본 설정 그대로
 *   ABP2 → I2C4: PD12 SCL (CN10-21), PD13 SDA (CN10-19)
 *
 * 처음엔 ABP2 를 I2C2 PF1/PF0 (CN9-19/21) 에 물렸지만, NUCLEO-H563ZI 는 PF0/PF1 이
 * 클럭(HSE/MCO) 납땜 브리지에 묶여 있어 브리지를 바꾸지 않으면 CN9 쪽에서 쓸 수 없음
 * (UM3115 클럭 소스 절). 그래서 브리지 변경 없이 쓰는 I2C4 로 옮김.
 * 풀업 10 kΩ 는 브레드보드에 달려 있음.
 */
/* ABP2 는 바깥 풀업 저항 없이 MCU 안쪽 풀업(약 40 kΩ, 핀 설정의 bias-pull-up)만 씀.
 * 안쪽 풀업은 약해서 선이 천천히 올라오므로 속도를 약 14 kHz 로 낮춤.
 * TIMINGR 0xF021FFFF: I2C4 클럭 120 MHz(PCLK3) 기준 PRESC 15 → 133 ns 단위,
 * SCLL = SCLH = 256 단위 = 34 µs, SCLDEL 3 단위, SDADEL 1 단위. */
&i2c4 {
	pinctrl-0 = <&i2c4_scl_pd12 &i2c4_sda_pd13>;
	pinctrl-names = "default";
	clock-frequency = <I2C_BITRATE_STANDARD>;
	timings = <120000000 I2C_BITRATE_STANDARD 0xF021FFFF>;
	status = "okay";
};
```

## src/main.c
```c
/*
 * 브레드보드 센서 확인 펌웨어 (NUCLEO-H563ZI)
 *
 * 1) 켜지면 I2C1(HSC) · I2C4(ABP2) 를 훑어 응답하는 주소를 찍음 (둘 다 0x28 이 보이면 배선 성공)
 * 2) 그다음 CONFIG_BENCH_SAMPLE_PERIOD_MS(지금 100 ms)마다 HSC(차압) · ABP2(정압) · SDP810(차압)을 읽어 찍음
 * 3) CONFIG_BENCH_SLOW_PERIOD_MS(1초)마다 BME280(대기압 · 주변 온도 · 습도, I2C4 0x76)과
 *    DS18B20(관 속 가스 온도, D2 = PG14)을 읽고, 그 값을 측정 줄 끝에 줄마다 붙임
 *
 * 센서 드라이버(hsc.c · abp2.c)는 제품 저장소 것을 그대로 쓰고,
 * 여기서는 그 드라이버가 쓰는 i2c_bus_t 를 Zephyr I2C 로 채워 주기만 함.
 */
#include <zephyr/kernel.h>
#include <zephyr/device.h>
#include <zephyr/drivers/i2c.h>
#include <zephyr/drivers/gpio.h>
#include <stm32_ll_gpio.h>
#include <stdarg.h>
#include <zephyr/sys/printk.h>

#include "i2c_bus.h"
#include "hsc.h"
#include "abp2.h"
#include "bench_net.h"
#include "sdp810.h"
#include "bme280.h"
#include "ds18b20.h"

static const struct device *const i2c_hsc = DEVICE_DT_GET(DT_NODELABEL(i2c1));
static const struct device *const i2c_abp2 = DEVICE_DT_GET(DT_NODELABEL(i2c4));

/* ---- 제품 드라이버용 버스 어댑터 ---- */

static int z_write(void *ctx, uint8_t addr, const uint8_t *d, size_t n)
{
	return i2c_write((const struct device *)ctx, d, n, addr) == 0 ? 0 : -1;
}

static int z_read(void *ctx, uint8_t addr, uint8_t *d, size_t n)
{
	return i2c_read((const struct device *)ctx, d, n, addr) == 0 ? 0 : -1;
}

static int z_write_read(void *ctx, uint8_t addr, const uint8_t *w, size_t wn, uint8_t *r, size_t rn)
{
	return i2c_write_read((const struct device *)ctx, addr, w, wn, r, rn) == 0 ? 0 : -1;
}

static void z_delay(void *ctx, uint32_t ms)
{
	ARG_UNUSED(ctx);
	k_msleep(ms);
}

static i2c_bus_t bus_of(const struct device *dev)
{
	return (i2c_bus_t){
		.write = z_write, .read = z_read, .write_read = z_write_read,
		.delay_ms = z_delay, .ctx = (void *)dev,
	};
}

/* 시리얼에 찍고, MQTT 로도 보냄 (측정 줄 · 영점 안내처럼 페이지가 쓰는 줄만) */
static void say(const char *fmt, ...)
{
	char line[320]; /* bench_net.c 의 LINE_MAX 와 같게 */
	va_list ap;

	va_start(ap, fmt);
	vsnprintk(line, sizeof(line), fmt, ap);
	va_end(ap);
	printk("%s\n", line);
	if (IS_ENABLED(CONFIG_BENCH_MQTT)) {
		bench_net_send(line);
	}
}

static const char *err_name(sens_err_t e)
{
	switch (e) {
	case SENS_OK: return "정상";
	case SENS_STALE: return "이전 값";
	case SENS_E_BUS: return "응답 없음";
	case SENS_E_ID: return "칩 번호 다름";
	case SENS_E_BUSY: return "변환 중";
	case SENS_E_STATUS: return "센서 오류 비트";
	case SENS_E_RANGE: return "범위 밖";
	default: return "?";
	}
}

/* ---- 선 상태: 풀업이 있으면 쉬는 동안 둘 다 높음(1) 이어야 함 ---- */

/* 배선 확인: 안쪽 풀다운(약 40 kΩ)을 잠깐 걸고 읽음.
 *   1 → 바깥 10 kΩ 풀업이 이 핀까지 닿아 있음 (선이 맞는 구멍에 꽂힘)
 *   0 → 이 핀에 풀업이 안 닿음 (선이 다른 구멍이거나 빠짐)
 * 끝나면 I2C 용 설정(대체 기능 · 안쪽 풀업)으로 되돌림. 대체 기능 번호와 open-drain 은
 * 입력으로 바꿔도 레지스터에 그대로 남아 있어서 모드와 풀업만 되돌리면 됨. */
static void wiring_probe(const char *name, const struct device *port, GPIO_TypeDef *regs, int scl,
			 int sda)
{
	gpio_port_value_t v = 0;

	gpio_pin_configure(port, scl, GPIO_INPUT | GPIO_PULL_DOWN);
	gpio_pin_configure(port, sda, GPIO_INPUT | GPIO_PULL_DOWN);
	k_msleep(5);
	if (gpio_port_get_raw(port, &v) == 0) {
		printk("[배선] %s: 풀다운 걸고 SCL=%d SDA=%d  (1 = 풀업 선이 핀에 닿음, 0 = 안 닿음)\n",
		       name, (int)((v >> scl) & 1), (int)((v >> sda) & 1));
	}
	LL_GPIO_SetPinMode(regs, BIT(scl), LL_GPIO_MODE_ALTERNATE);
	LL_GPIO_SetPinMode(regs, BIT(sda), LL_GPIO_MODE_ALTERNATE);
	LL_GPIO_SetPinPull(regs, BIT(scl), LL_GPIO_PULL_UP);
	LL_GPIO_SetPinPull(regs, BIT(sda), LL_GPIO_PULL_UP);
	k_msleep(2);
}

/* 선 찾기: 모든 GPIO 핀을 잠깐 입력 + 안쪽 풀다운으로 바꿔 읽고 바로 되돌림.
 * 1 로 읽히는 핀 = 바깥 풀업(브레드보드 10 kΩ 등)이 닿아 있는 핀. 신호선이 실제로 꽂힌 핀을 찾는 용도.
 * 디버그(PA13/PA14), 로그 UART(PD8/PD9), 클럭(PC14/PC15/PH0/PH1)은 건드리지 않음. */
static void find_pullups(void)
{
	GPIO_TypeDef *const ports[] = {GPIOA, GPIOB, GPIOC, GPIOD, GPIOE, GPIOF, GPIOG, GPIOH, GPIOI};
	const char names[] = "ABCDEFGHI";

	printk("[찾기] 바깥 풀업이 닿은 핀:");
	for (int p = 0; p < ARRAY_SIZE(ports); p++) {
		GPIO_TypeDef *g = ports[p];

		for (int pin = 0; pin < 16; pin++) {
			char c = names[p];

			if ((c == 'A' && (pin == 13 || pin == 14)) || (c == 'D' && (pin == 8 || pin == 9)) ||
			    (c == 'C' && (pin == 14 || pin == 15)) || (c == 'H' && (pin == 0 || pin == 1))) {
				continue;
			}
			uint32_t m = g->MODER, pu = g->PUPDR, sh = 2u * pin;

			g->PUPDR = (pu & ~(3u << sh)) | (2u << sh);
			g->MODER = m & ~(3u << sh);
			k_busy_wait(50);
			uint32_t hi = (g->IDR >> pin) & 1u;

			g->MODER = m;
			g->PUPDR = pu;
			if (hi) {
				printk(" P%c%d", c, pin);
			}
		}
	}
	printk("\n");
}

/* 버스 복구: 센서가 통신 도중 멈춰 SDA 를 붙잡고 있으면, SCL 을 최대 16번 쳐서 놓게 하고 STOP 을 보냄.
 * 핀을 잠깐 GPIO open-drain 출력으로 쓰고, 끝나면 I2C 대체 기능으로 되돌림. 끝난 뒤 SDA 값을 돌려줌. */
static int bus_recover(const char *name, GPIO_TypeDef *g, int scl, int sda)
{
	const uint32_t ms = 3u << (2u * scl), md = 3u << (2u * sda);
	uint32_t moder = g->MODER;
	int clocks = 0;

	g->OTYPER |= BIT(scl) | BIT(sda);
	g->BSRR = BIT(scl) | BIT(sda);
	g->MODER = (moder & ~(ms | md)) | (1u << (2u * scl)) | (1u << (2u * sda));
	k_busy_wait(100);
	while (clocks < 16 && !((g->IDR >> sda) & 1u)) {
		g->BSRR = BIT(scl) << 16;
		k_busy_wait(60);
		g->BSRR = BIT(scl);
		k_busy_wait(60);
		clocks++;
	}
	/* STOP: SCL 높음에서 SDA 를 낮음 → 높음 */
	g->BSRR = BIT(scl) << 16;
	k_busy_wait(60);
	g->BSRR = BIT(sda) << 16;
	k_busy_wait(60);
	g->BSRR = BIT(scl);
	k_busy_wait(60);
	g->BSRR = BIT(sda);
	k_busy_wait(100);
	int sda_now = (g->IDR >> sda) & 1u;

	g->MODER = (g->MODER & ~(ms | md)) | (2u << (2u * scl)) | (2u << (2u * sda));
	printk("[복구] %s: SCL 클럭 %d번 보냄 → SDA=%d (%s)\n", name, clocks, sda_now,
	       sda_now ? "풀림" : "여전히 0. 센서가 아니라 배선이 GND 로 당기는 것");
	return sda_now;
}

static bool lines_ok(const char *name, const struct device *port, int scl, int sda)
{
	gpio_port_value_t v = 0;

	if (gpio_port_get_raw(port, &v) != 0) {
		printk("[선]   %s: 포트 못 읽음\n", name);
		return true;
	}
	int l_scl = (v >> scl) & 1, l_sda = (v >> sda) & 1;

	printk("[선]   %s: SCL=%d SDA=%d", name, l_scl, l_sda);
	if (l_scl && l_sda) {
		printk("  정상\n");
		return true;
	}
	printk("  <- 0 인 선이 있음. 풀업 저항(3V3 쪽)이 빠졌거나, 선이 GND 에 붙었거나, 센서 전원이 없음\n");

	/* 원인 가르기: MCU 안쪽 풀업(약 40 kΩ)을 잠깐 켜고 다시 읽음.
	 *   1 이 되면 → 바깥 풀업 길이 끊김 (저항 · 아래 + 줄 다리 선 · 신호선이 안 닿음)
	 *   0 그대로면 → 무언가가 선을 GND 쪽으로 당김 (센서 전원 없음 · 합선 · 3V3 대신 GND 에 꽂힌 저항)
	 * 이 버스는 이후에 쓰지 않으므로 핀 설정을 되돌리지 않음. */
	gpio_pin_configure(port, scl, GPIO_INPUT | GPIO_PULL_UP);
	gpio_pin_configure(port, sda, GPIO_INPUT | GPIO_PULL_UP);
	k_msleep(5);
	if (gpio_port_get_raw(port, &v) == 0) {
		int p_scl = (v >> scl) & 1, p_sda = (v >> sda) & 1;

		printk("[진단] %s: 안쪽 풀업 켜면 SCL=%d SDA=%d\n", name, p_scl, p_sda);
		printk("[진단] 1 인 선 = 바깥 풀업 길이 끊김(저항, 아래 + 줄 다리 선, 신호선 자리)\n");
		printk("[진단] 0 인 선 = 무언가가 GND 쪽으로 당김(센서 전원 없음, 합선)\n");
	}
	return false;
}

/* ---- 버스 훑기 ---- */

static int scan(const char *name, const struct device *dev)
{
	uint8_t b;
	int found = 0;
	char addrs[96] = "";
	size_t len = 0;

	if (!device_is_ready(dev)) {
		say("[스캔] %s: 장치 준비 안 됨", name);
		return 0;
	}
	for (uint8_t a = 0x08; a < 0x78; a++) {
		if (i2c_read(dev, &b, 1, a) == 0) {
			if (len < sizeof(addrs) - 6) {
				len += snprintk(addrs + len, sizeof(addrs) - len, " 0x%02x", a);
			}
			found++;
		}
	}
	/* MQTT 로도 가서 USB 없이도 보드 로그(board_serial.log)에서 배선 확인 가능 */
	if (found) {
		say("[스캔] %s:%s  (%d개)", name, addrs, found);
	} else {
		say("[스캔] %s: 없음", name);
	}
	return found;
}

/* ---- HSC 차압 영점 ----
 * 포트 둘 다 열려 있을 때(실제 차압 0) 읽은 평균이 센서의 영점 오차임. 그만큼 빼서 찍음.
 * 켜질 때 한 번 잡고, 파란 USER 버튼(B1)을 누르면 다시 잡음.
 */
#define HSC_FAST_MAX 20 /* 측정 줄 하나에 모아 보낼 HSC 값 최대 개수 (100 ms, 1초 주기면 10개) */
#define HSC_ZERO_MAX_PA 50.0 /* 이보다 크면 포트에 압력이 걸린 걸로 보고 거절 (만점 폭의 2.5 %) */

static const struct gpio_dt_spec user_btn = GPIO_DT_SPEC_GET(DT_ALIAS(sw0), gpios);
static struct gpio_callback user_btn_cb;
static atomic_t rezero_req;

static void user_btn_pressed(const struct device *dev, struct gpio_callback *cb, uint32_t pins)
{
	ARG_UNUSED(dev);
	ARG_UNUSED(cb);
	ARG_UNUSED(pins);
	atomic_set(&rezero_req, 1);
}

static void user_btn_init(void)
{
	if (!gpio_is_ready_dt(&user_btn) || gpio_pin_configure_dt(&user_btn, GPIO_INPUT) != 0 ||
	    gpio_pin_interrupt_configure_dt(&user_btn, GPIO_INT_EDGE_TO_ACTIVE) != 0) {
		printk("USER 버튼 설정 실패: 영점은 켜질 때만 잡음\n");
		return;
	}
	gpio_init_callback(&user_btn_cb, user_btn_pressed, BIT(user_btn.pin));
	gpio_add_callback(user_btn.port, &user_btn_cb);
}

/* 찍는 HSC 차압 = 기울기 × (읽은 값 − 영점) + 오프셋. 기울기 · 오프셋은 SDP810 기준으로 맞춘 값 (Kconfig) */
static double hsc_cal(double raw_pa, double zero_pa)
{
	return (raw_pa - zero_pa) * (CONFIG_BENCH_HSC_GAIN_PPM / 1e6) + CONFIG_BENCH_HSC_OFFSET_MPA / 1000.0;
}

#define HSC_TRACK_BAND_PA 1.0 /* SDP810 이 이 안쪽일 때만 '흐름 없음' 으로 보고 HSC 0점을 맞춤 */

/* HSC 를 CONFIG_BENCH_HSC_OVERSAMPLE 번 읽어 평균 (눈금 한 칸 0.15 Pa 씩 튀는 흔들림을 줄임).
 * 새 값(SENS_OK)만 평균에 넣고, 새 값이 하나도 없으면 마지막 결과를 그대로 돌려줌. */
static sens_err_t hsc_read_avg(const i2c_bus_t *bus, const hsc_cfg_t *cfg, hsc_reading_t *out)
{
	double sum = 0.0;
	int got = 0;
	sens_err_t last = SENS_E_BUS;

	for (int i = 0; i < CONFIG_BENCH_HSC_OVERSAMPLE; i++) {
		hsc_reading_t h = {0};

		if (i > 0) {
			k_msleep(CONFIG_BENCH_HSC_OVERSAMPLE_GAP_MS);
		}
		last = hsc_read(bus, cfg, &h);
		if (last == SENS_OK) {
			sum += h.p_pa;
			got++;
			*out = h;
		} else if (last == SENS_STALE && got == 0) {
			*out = h;
		}
	}
	if (got == 0) {
		return last;
	}
	out->p_pa = sum / got;
	return SENS_OK;
}

/* 20 ms 간격으로 여러 번 읽어 평균 (HSC 는 스스로 계속 재고 있어, 너무 빨리 읽으면 같은 값이 옴) */
static bool hsc_take_zero(const i2c_bus_t *bus, const hsc_cfg_t *cfg, double *zero_pa)
{
	double sum = 0.0;
	int got = 0;

	for (int i = 0; i < CONFIG_BENCH_HSC_ZERO_SAMPLES; i++) {
		hsc_reading_t h;

		if (hsc_read(bus, cfg, &h) == SENS_OK) {
			sum += h.p_pa;
			got++;
		}
		k_msleep(20);
	}
	if (got < CONFIG_BENCH_HSC_ZERO_SAMPLES / 2) {
		say("HSC 영점 못 잡음: %d/%d 번만 읽힘", got, CONFIG_BENCH_HSC_ZERO_SAMPLES);
		return false;
	}
	double z = sum / got;

	if (z > HSC_ZERO_MAX_PA || z < -HSC_ZERO_MAX_PA) {
		say("HSC 영점 거절: 평균 %.2f Pa (±%.0f Pa 넘음, 포트 둘 다 열고 다시 USER 버튼)", z,
		    HSC_ZERO_MAX_PA);
		return false;
	}
	*zero_pa = z;
	say("HSC 영점 %.2f Pa (%d번 평균). 이제 찍는 HSC 차압은 이만큼 뺀 값. "
	    "다시 잡으려면 포트 둘 다 열고 파란 USER 버튼.",
	    z, got);
	return true;
}

int main(void)
{
	i2c_bus_t hsc_bus = bus_of(i2c_hsc);
	i2c_bus_t abp2_bus = bus_of(i2c_abp2);
	hsc_cfg_t hcfg;
	abp2_cfg_t acfg;

	hsc_default_cfg(&hcfg);
	abp2_default_cfg(&acfg);
	acfg.p_max_pa = CONFIG_BENCH_ABP2_MAX_PA; /* 붙은 부품 범위와 같아야 함 (ABP2DRNT006KG = 6000) */

	k_msleep(100);
	printk("\n=== 브레드보드 센서 확인 ===\n");
	if (IS_ENABLED(CONFIG_BENCH_MQTT)) {
		bench_net_start();
	}
	printk("HSC  = I2C1 (CN7-2 SCL, CN7-4 SDA)\n");
	printk("ABP2 = I2C4 (CN10-21 SCL, CN10-19 SDA), 안쪽 풀업 + 느린 속도, 범위 0–%d Pa\n",
	       CONFIG_BENCH_ABP2_MAX_PA);
	printk("I2C4 TIMINGR=0x%08x (0xF021FFFF 면 약 14 kHz 적용됨)\n", (unsigned int)I2C4->TIMINGR);
	find_pullups();
	wiring_probe("I2C1 HSC ",DEVICE_DT_GET(DT_NODELABEL(gpiob)),
		     (GPIO_TypeDef *)DT_REG_ADDR(DT_NODELABEL(gpiob)), 8, 9);
	wiring_probe("I2C4 ABP2", DEVICE_DT_GET(DT_NODELABEL(gpiod)),
		     (GPIO_TypeDef *)DT_REG_ADDR(DT_NODELABEL(gpiod)), 12, 13);
	bool ok1 = lines_ok("I2C1 HSC ", DEVICE_DT_GET(DT_NODELABEL(gpiob)), 8, 9);
	bool ok2 = lines_ok("I2C4 ABP2", DEVICE_DT_GET(DT_NODELABEL(gpiod)), 12, 13);

	if (!ok2) {
		ok2 = bus_recover("I2C4 ABP2", (GPIO_TypeDef *)DT_REG_ADDR(DT_NODELABEL(gpiod)), 12,
				  13) != 0;
		if (ok2) {
			/* lines_ok 의 진단이 핀을 입력으로 바꿔 둔 상태라, 안쪽 풀업을 다시 켬 */
			LL_GPIO_SetPinPull((GPIO_TypeDef *)DT_REG_ADDR(DT_NODELABEL(gpiod)), BIT(12),
					   LL_GPIO_PULL_UP);
			LL_GPIO_SetPinPull((GPIO_TypeDef *)DT_REG_ADDR(DT_NODELABEL(gpiod)), BIT(13),
					   LL_GPIO_PULL_UP);
		}
	}

	if (ok1) {
		scan("I2C1 HSC ", i2c_hsc);
	}
	if (ok2) {
		scan("I2C4 ABP2", i2c_abp2);
	}
	if (!ok1 || !ok2) {
		printk("선이 막힌 버스는 건너뜀 (막힌 버스를 건드리면 멈춤). 배선 고친 뒤 리셋 버튼 누르기.\n");
	}
	const uint32_t period_ms = CONFIG_BENCH_SAMPLE_PERIOD_MS;

	printk("둘 다 0x28 이 보이면 배선 성공. 이제 %u ms 마다 읽음 (CONFIG_BENCH_SAMPLE_PERIOD_MS).\n\n",
	       period_ms);

	double hsc_zero_pa = 0.0;

	if (CONFIG_BENCH_HSC_GAIN_PPM != 1000000 || CONFIG_BENCH_HSC_OFFSET_MPA != 0) {
		say("HSC 보정: 기울기 %.6f, 오프셋 %.3f Pa (SDP810 기준)", CONFIG_BENCH_HSC_GAIN_PPM / 1e6,
		    CONFIG_BENCH_HSC_OFFSET_MPA / 1000.0);
	}

	if (IS_ENABLED(CONFIG_BENCH_HSC_ZERO) && ok1) {
		user_btn_init();
		hsc_take_zero(&hsc_bus, &hcfg, &hsc_zero_pa);
	}

	/* SDP810: HSC 와 같은 I2C1 (주소 0x25 라 안 겹침). 안 붙어 있으면 5초마다 다시 찾음 */
	bool sdp_on = false;

	if (IS_ENABLED(CONFIG_BENCH_SDP810) && ok1) {
		sdp_on = sdp810_start(&hsc_bus) == SENS_OK;
		say(sdp_on ? "SDP810 (I2C1 0x25) 연속 측정 시작"
			   : "SDP810 (I2C1 0x25) 응답 없음: 안 붙어 있으면 정상, 5초마다 다시 찾음");
	}

	/* BME280: 정압 센서와 같은 I2C4 (주소 0x76 이라 안 겹침). 대기압 → 절대압 = 대기압 + ABP2 정압 */
	bme280_cal_t bme_cal = {0};
	bme280_reading_t bme_v = {0};
	bool bme_on = false;
	sens_err_t bme_e = SENS_E_BUS;

	if (IS_ENABLED(CONFIG_BENCH_BME280) && ok2) {
		sens_err_t e = bme280_start(&abp2_bus, &bme_cal);

		bme_on = e == SENS_OK;
		bme_e = bme_on ? SENS_E_BUSY : e; /* 첫 값이 나올 때까지 "변환 중" */
		say(bme_on ? "%s (I2C4 0x76) 연속 측정 시작"
			   : "BME280 (I2C4 0x76) %s: 안 붙어 있으면 정상, 5초마다 다시 찾음",
		    bme_on ? (bme_cal.has_hum ? "BME280" : "BMP280(습도 없음)") : err_name(e));
	}

	/* DS18B20: 1-Wire, 데이터 선 = D2 (PG14). 관 속 가스 온도 */
	ds18b20_t ds = {0};
	bool ds_on = false, ds_conv = false; /* ds_conv: 변환을 걸어 둠 → 750 ms 지나면 읽을 값이 있음 */
	int64_t ds_conv_at = 0;
	sens_err_t ds_e = SENS_E_BUS;
	double ds_c = 0.0;

	if (IS_ENABLED(CONFIG_BENCH_DS18B20)) {
		uint8_t rom[8] = {0};
		sens_err_t e = ds18b20_start(&ds, DEVICE_DT_GET(DT_NODELABEL(gpiog)), 14, rom);

		ds_on = e == SENS_OK;
		ds_e = ds_on ? SENS_E_BUSY : e;
		if (ds_on) {
			say("DS18B20 (D2 = PG14) 찾음: 주소 %02x-%02x%02x%02x%02x%02x%02x%s", rom[0], rom[6], rom[5],
			    rom[4], rom[3], rom[2], rom[1],
			    rom[0] == 0x28 ? "" : rom[0] == 0x10 ? " (DS18S20)" : " (DS18B20 이 아닌 종류)");
			ds_conv = ds18b20_convert(&ds) == SENS_OK;
			ds_conv_at = k_uptime_get();
		} else {
			say("DS18B20 (D2 = PG14) %s: 안 붙어 있으면 정상, 5초마다 다시 찾음", err_name(e));
		}
	}
	/* 느린 센서 둘은 slow_n 줄에 한 번만 읽음 (서로 반 박자 어긋나게 해서 한 줄이 너무 길어지지 않게) */
	const uint32_t slow_n = MAX(1u, CONFIG_BENCH_SLOW_PERIOD_MS / period_ms);
	const uint32_t retry_n = MAX(1u, 5000u / period_ms);

	int64_t next = k_uptime_get();
	/* 측정 줄 사이에 CONFIG_BENCH_HSC_FAST_MS 마다 읽은 HSC 값 (다음 측정 줄 때 한꺼번에 보냄) */
	double fast_v[HSC_FAST_MAX];
	bool fast_ok[HSC_FAST_MAX];
	int fast_n = 0;
	double fast_t = 0.0;
	double hsc_smooth = 0.0; /* 찍는 HSC 값의 이동 평균 */
	bool hsc_smooth_on = false;

	for (uint32_t n = 1;; n++) {
		if (IS_ENABLED(CONFIG_BENCH_HSC_ZERO) && ok1 && atomic_cas(&rezero_req, 1, 0)) {
			hsc_take_zero(&hsc_bus, &hcfg, &hsc_zero_pa);
			next = k_uptime_get();
			fast_n = 0; /* 영점 잡는 동안 모인 값은 버림 */
			hsc_smooth_on = false;
		}
		hsc_reading_t h = {0};
		abp2_reading_t p = {0};
		uint32_t t0 = k_cycle_get_32();
		sens_err_t he = ok1 ? hsc_read_avg(&hsc_bus, &hcfg, &h) : SENS_E_BUS;
		sens_err_t pe = ok2 ? abp2_measure(&abp2_bus, &acfg, &p) : SENS_E_BUS;
		char ss[64] = "";
		bool sdp_ok = false; /* 이번 줄의 SDP810 값 (HSC 0점을 맞추는 기준) */
		double sdp_pa = 0.0;

		if (IS_ENABLED(CONFIG_BENCH_SDP810) && ok1) {
			if (!sdp_on && n % 5 == 0) {
				sdp_on = sdp810_start(&hsc_bus) == SENS_OK;
				if (sdp_on) {
					say("SDP810 (I2C1 0x25) 찾음, 연속 측정 시작");
				}
			}
			sdp810_reading_t s = {0};
			sens_err_t se = sdp_on ? sdp810_read(&hsc_bus, &s) : SENS_E_BUS;

			if (se == SENS_E_BUS) {
				sdp_on = false;
			}
			if (se == SENS_OK) {
				sdp_ok = true;
				sdp_pa = s.p_pa;
			}
			if (se == SENS_OK || se == SENS_E_RANGE) {
				snprintk(ss, sizeof(ss), "  |  SDP810 %s %.2f Pa %.1f C", err_name(se), s.p_pa,
					 s.t_c);
			} else {
				snprintk(ss, sizeof(ss), "  |  SDP810 %s", err_name(se));
			}
		}
		uint32_t read_us = (uint32_t)k_cyc_to_us_floor64(k_cycle_get_32() - t0);

		/* 느린 센서 (read_us 에는 안 넣음: 위 세 센서를 읽는 시간만 봄) */
		char es[112] = "";
		size_t el = 0;

		if (IS_ENABLED(CONFIG_BENCH_BME280) && ok2) {
			if (!bme_on && n % retry_n == 0) {
				bme_on = bme280_start(&abp2_bus, &bme_cal) == SENS_OK;
				if (bme_on) {
					say("BME280 (I2C4 0x76) 찾음, 연속 측정 시작");
					bme_e = SENS_E_BUSY;
				}
			} else if (bme_on && n % slow_n == 0) {
				bme_e = bme280_read(&abp2_bus, &bme_cal, &bme_v);
				if (bme_e == SENS_E_BUS || (bme_e == SENS_E_BUSY && n > 3 * slow_n)) {
					bme_on = false; /* 빠졌거나, 전원이 끊겼다 돌아와 잠든 상태 → 다시 찾아 설정 */
				}
			}
			if (bme_e == SENS_OK || bme_e == SENS_E_RANGE) {
				el += snprintk(es + el, sizeof(es) - el, "  |  BME280 %s %.1f Pa %.2f C", err_name(bme_e),
					       bme_v.p_pa, bme_v.t_c);
				if (bme_cal.has_hum) {
					el += snprintk(es + el, sizeof(es) - el, " %.1f %%", bme_v.rh);
				}
			} else {
				el += snprintk(es + el, sizeof(es) - el, "  |  BME280 %s", err_name(bme_e));
			}
		}
		if (IS_ENABLED(CONFIG_BENCH_DS18B20)) {
			if (!ds_on && n % retry_n == retry_n / 2) {
				uint8_t rom[8];

				ds_on = ds18b20_start(&ds, DEVICE_DT_GET(DT_NODELABEL(gpiog)), 14, rom) == SENS_OK;
				if (ds_on) {
					say("DS18B20 (D2 = PG14) 찾음, 측정 시작");
					ds_e = SENS_E_BUSY;
					ds_conv = ds18b20_convert(&ds) == SENS_OK;
					ds_conv_at = k_uptime_get();
				}
			} else if (ds_on && n % slow_n == slow_n / 2 &&
				   !(ds_conv && k_uptime_get() - ds_conv_at < 750)) { /* 변환이 덜 끝났으면 다음 차례에 */
				if (ds_conv) {
					ds_e = ds18b20_read(&ds, &ds_c);
				}
				ds_conv = ds18b20_convert(&ds) == SENS_OK;
				ds_conv_at = k_uptime_get();
				if (ds_e == SENS_E_BUS || !ds_conv) {
					ds_on = false;
					ds_e = SENS_E_BUS;
				}
			}
			if (el < sizeof(es)) {
				if (ds_e == SENS_OK || ds_e == SENS_STALE) {
					snprintk(es + el, sizeof(es) - el, "  |  DS18B20 %s %.2f C", err_name(ds_e), ds_c);
				} else {
					snprintk(es + el, sizeof(es) - el, "  |  DS18B20 %s", err_name(ds_e));
				}
			}
		}

		/* 맨 앞의 [...] 는 페이지와 MCP 서버가 읽어 갱신 간격을 맞추는 데 씀 */
		char hs[40] = "", ps[48] = "";

		/* HSC: 그 사이 CONFIG_BENCH_HSC_FAST_MS 마다 읽어 둔 값 + 방금 값. 측정 줄에는 평균을 찍고,
		 * 값 하나하나는 바로 뒤 "[hsc 100 ms] #n v1 v2 ..." 줄로 보냄 (못 읽은 칸은 x) */
		bool h_ok = he == SENS_OK || he == SENS_STALE;

		if (fast_n < HSC_FAST_MAX) {
			fast_v[fast_n] = h.p_pa;
			fast_ok[fast_n] = h_ok;
			fast_n++;
		}
		if (h_ok) {
			fast_t = h.t_c;
		}
		double sum = 0.0;
		int cnt = 0;

		for (int i = 0; i < fast_n; i++) {
			if (fast_ok[i]) {
				sum += fast_v[i];
				cnt++;
			}
		}
		if (cnt > 0) {
			if (!h_ok) {
				he = SENS_OK; /* 이번만 실패했고 그 사이 값은 있음 */
			}
			double hv = hsc_cal(sum / cnt, hsc_zero_pa);

			/* 부드럽게 하기: 최근 값들의 이동 평균(시정수 CONFIG_BENCH_HSC_SMOOTH_TAU_MS).
			 * 새 값이 지금 평균과 CONFIG_BENCH_HSC_SMOOTH_JUMP_MPA 넘게 다르면 진짜 압력 변화로 보고
			 * 평균을 버리고 바로 그 값으로 감 (큰 변화에는 늦지 않게). */
			double shown = hv;

			if (CONFIG_BENCH_HSC_SMOOTH_TAU_MS > 0) {
				double d = hv - hsc_smooth;

				if (!hsc_smooth_on || d > CONFIG_BENCH_HSC_SMOOTH_JUMP_MPA / 1000.0 ||
				    d < -CONFIG_BENCH_HSC_SMOOTH_JUMP_MPA / 1000.0) {
					hsc_smooth = hv;
					hsc_smooth_on = true;
				} else {
					double a = (double)period_ms / CONFIG_BENCH_HSC_SMOOTH_TAU_MS;

					hsc_smooth += d * (a > 1.0 ? 1.0 : a);
				}
				shown = hsc_smooth;
			}
			snprintk(hs, sizeof(hs), " %.2f Pa %.1f C", shown, fast_t);

			/* 흐름이 없을 때(SDP810 이 0 근처)만 HSC 0점을 SDP810 쪽으로 천천히 끌어감.
			 * HSC 0점은 켜진 뒤에도 온도에 따라 0.2 ~ 0.4 Pa 씩 흘러서, 그대로 두면 SDP810 과 어긋남.
			 * 두 값이 5 Pa 넘게 다르면 한쪽만 압력을 받는 중이라 건드리지 않음. */
			double diff = hv - sdp_pa;

			if (IS_ENABLED(CONFIG_BENCH_HSC_TRACK_SDP) && sdp_ok && h_ok &&
			    sdp_pa > -HSC_TRACK_BAND_PA && sdp_pa < HSC_TRACK_BAND_PA && diff > -5.0 && diff < 5.0) {
				double step = diff * ((double)period_ms / (CONFIG_BENCH_HSC_TRACK_TAU_S * 1000.0));

				hsc_zero_pa += step / (CONFIG_BENCH_HSC_GAIN_PPM / 1e6);
				hsc_smooth -= step; /* 0점이 움직인 만큼 평균도 같이 옮김 */
			}
		}
		if (pe == SENS_OK || pe == SENS_E_RANGE) {
			snprintk(ps, sizeof(ps), " %.1f Pa %.2f C (st 0x%02x)", p.p_pa, p.t_c, p.status);
		}
		say("[period %u ms, read %u us] #%u  HSC %s%s  |  ABP2 %s%s%s%s", period_ms, read_us, n,
		    err_name(he), hs, err_name(pe), ps, ss, es);

		if (CONFIG_BENCH_HSC_FAST_MS > 0 && ok1 && fast_n > 1) {
			char vl[200];
			int len = snprintk(vl, sizeof(vl), "[hsc %d ms] #%u ", CONFIG_BENCH_HSC_FAST_MS, n);

			for (int i = 0; i < fast_n && len < (int)sizeof(vl) - 10; i++) {
				len += fast_ok[i] ? snprintk(vl + len, sizeof(vl) - len, " %.2f",
							     hsc_cal(fast_v[i], hsc_zero_pa))
						  : snprintk(vl + len, sizeof(vl) - len, " x");
			}
			say("%s", vl);
		}
		fast_n = 0;

		/* 읽기 시작 시각 기준으로 일정한 간격 유지 (읽는 시간만큼 밀리지 않게) */
		int64_t t_start = next;

		next += period_ms;

		/* 다음 측정까지 HSC 만 CONFIG_BENCH_HSC_FAST_MS 마다 읽어 쌓아 둠 (다음 줄에서 평균) */
		if (CONFIG_BENCH_HSC_FAST_MS > 0 && ok1) {
			for (int64_t tick = t_start + CONFIG_BENCH_HSC_FAST_MS; tick < next;
			     tick += CONFIG_BENCH_HSC_FAST_MS) {
				int64_t w = tick - k_uptime_get();

				if (w > 0) {
					k_msleep((int32_t)w);
				}
				hsc_reading_t f = {0};
				sens_err_t fe = hsc_read(&hsc_bus, &hcfg, &f);

				if (fast_n < HSC_FAST_MAX) {
					fast_v[fast_n] = f.p_pa;
					fast_ok[fast_n] = fe == SENS_OK || fe == SENS_STALE;
					fast_n++;
				}
				if (fe == SENS_OK || fe == SENS_STALE) {
					fast_t = f.t_c;
				}
			}
		}
		int64_t wait = next - k_uptime_get();
		if (wait > 0) {
			k_msleep((int32_t)wait);
		} else {
			next = k_uptime_get();
		}
	}
	return 0;
}
```

## src/bench_net.c
```c
/*
 * 이더넷(DHCP) + MQTT 전송
 *
 * - 랜선이 꽂히면 DHCP 로 주소를 받고, CONFIG_BENCH_MQTT_BROKER 의 브로커에 붙음.
 * - main 이 시리얼에 찍는 줄을 그대로 받아 대기열에 쌓고, 붙어 있으면 오래된 것부터 보냄.
 *   끊긴 동안은 CONFIG_BENCH_MQTT_QUEUE 줄까지 쌓아 두고, 넘치면 가장 오래된 줄을 버림.
 * - 끊기면 5초마다 다시 붙음.
 *
 * 토픽 (CONFIG_BENCH_MQTT_TOPIC = T):
 *   T/line    측정 줄과 안내 줄 (시리얼 출력과 같은 글)
 *   T/status  "online <보드 IP>" (retain). 보드가 끊기면 브로커가 "offline" 으로 바꿈 (will)
 */
#include <errno.h>
#include <string.h>
#include <zephyr/kernel.h>
#include <zephyr/sys/printk.h>
#include <zephyr/net/net_if.h>
#include <zephyr/net/net_mgmt.h>
#include <zephyr/net/net_ip.h>
#include <zephyr/net/dhcpv4.h>
#include <zephyr/net/socket.h>
#include <zephyr/net/mqtt.h>

#include "bench_net.h"

#define LINE_MAX     320 /* 측정 줄 최대 길이 (센서 5개가 다 붙으면 약 230 바이트). main.c 의 say() 와 같게 */
#define RETRY_MS     5000
#define CONNACK_WAIT 5000

#define TOPIC_LINE   CONFIG_BENCH_MQTT_TOPIC "/line"
#define TOPIC_STATUS CONFIG_BENCH_MQTT_TOPIC "/status"

K_MSGQ_DEFINE(line_q, LINE_MAX, CONFIG_BENCH_MQTT_QUEUE, 4);

static K_SEM_DEFINE(got_address, 0, 1);
static struct net_mgmt_event_callback mgmt_cb;
static char my_ip[NET_IPV4_ADDR_LEN] = "?";

static struct mqtt_client client;
static struct net_sockaddr_storage broker;
static struct mqtt_utf8 user, pass;
static struct mqtt_topic will_topic;
static struct mqtt_utf8 will_msg;
static uint8_t rx_buf[256];
static uint8_t tx_buf[LINE_MAX + 128];
static volatile bool connected;
static uint16_t next_msg_id = 1;

void bench_net_send(const char *line)
{
	char slot[LINE_MAX];

	strncpy(slot, line, sizeof(slot) - 1);
	slot[sizeof(slot) - 1] = '\0';
	while (k_msgq_put(&line_q, slot, K_NO_WAIT) != 0) {
		char junk[LINE_MAX];

		(void)k_msgq_get(&line_q, junk, K_NO_WAIT); /* 꽉 찼으면 가장 오래된 줄 버림 */
	}
}

static void on_net_event(struct net_mgmt_event_callback *cb, uint64_t event, struct net_if *iface)
{
	struct net_if_ipv4 *ipv4;

	ARG_UNUSED(cb);
	if (event != NET_EVENT_IPV4_ADDR_ADD) {
		return;
	}
	ipv4 = iface->config.ip.ipv4;
	for (int i = 0; i < NET_IF_MAX_IPV4_ADDR; i++) {
		struct net_if_addr *a = &ipv4->unicast[i].ipv4;
		char gw[NET_IPV4_ADDR_LEN];

		if (!a->is_used || a->addr_type != NET_ADDR_DHCP) {
			continue;
		}
		net_addr_ntop(NET_AF_INET, &a->address.in_addr, my_ip, sizeof(my_ip));
		net_addr_ntop(NET_AF_INET, &ipv4->gw, gw, sizeof(gw));
		printk("[네트] DHCP 주소 %s (게이트웨이 %s). 브로커 %s:%d 로 보냄\n", my_ip, gw,
		       CONFIG_BENCH_MQTT_BROKER, CONFIG_BENCH_MQTT_PORT);
		k_sem_give(&got_address);
		return;
	}
}

static void evt_handler(struct mqtt_client *c, const struct mqtt_evt *evt)
{
	ARG_UNUSED(c);

	switch (evt->type) {
	case MQTT_EVT_CONNACK:
		if (evt->result == 0) {
			connected = true;
		} else {
			printk("[네트] 브로커가 연결 거부 (CONNACK %d): 계정 확인 (secrets.conf)\n",
			       evt->result);
		}
		break;
	case MQTT_EVT_DISCONNECT:
		connected = false;
		break;
	default:
		break;
	}
}

static int client_setup(void)
{
	struct net_sockaddr_in *b = (struct net_sockaddr_in *)&broker;

	mqtt_client_init(&client);

	b->sin_family = NET_AF_INET;
	b->sin_port = net_htons(CONFIG_BENCH_MQTT_PORT);
	if (net_addr_pton(NET_AF_INET, CONFIG_BENCH_MQTT_BROKER, &b->sin_addr) != 0) {
		printk("[네트] 브로커 주소 형식 오류: %s\n", CONFIG_BENCH_MQTT_BROKER);
		return -EINVAL;
	}

	user.utf8 = (const uint8_t *)CONFIG_BENCH_MQTT_USER;
	user.size = strlen(CONFIG_BENCH_MQTT_USER);
	pass.utf8 = (const uint8_t *)CONFIG_BENCH_MQTT_PASSWORD;
	pass.size = strlen(CONFIG_BENCH_MQTT_PASSWORD);

	will_topic.topic.utf8 = (const uint8_t *)TOPIC_STATUS;
	will_topic.topic.size = strlen(TOPIC_STATUS);
	will_topic.qos = MQTT_QOS_0_AT_MOST_ONCE;
	will_msg.utf8 = (const uint8_t *)"offline";
	will_msg.size = strlen("offline");

	client.broker = &broker;
	client.evt_cb = evt_handler;
	client.client_id.utf8 = (const uint8_t *)CONFIG_BENCH_MQTT_CLIENT_ID;
	client.client_id.size = strlen(CONFIG_BENCH_MQTT_CLIENT_ID);
	client.user_name = user.size ? &user : NULL;
	client.password = pass.size ? &pass : NULL;
	client.will_topic = &will_topic;
	client.will_message = &will_msg;
	client.will_retain = 1;
	client.protocol_version = MQTT_VERSION_3_1_1;
	client.rx_buf = rx_buf;
	client.rx_buf_size = sizeof(rx_buf);
	client.tx_buf = tx_buf;
	client.tx_buf_size = sizeof(tx_buf);
	client.transport.type = MQTT_TRANSPORT_NON_SECURE;
	return 0;
}

/* 소켓에 들어온 게 있으면 처리. 0 = 정상(타임아웃 포함), 음수 = 끊김 */
static int pump_input(int timeout_ms)
{
	struct zsock_pollfd fds = {
		.fd = client.transport.tcp.sock,
		.events = ZSOCK_POLLIN,
	};
	int ret = zsock_poll(&fds, 1, timeout_ms);

	if (ret < 0) {
		return -errno;
	}
	if (ret == 0) {
		return 0;
	}
	if (fds.revents & (ZSOCK_POLLERR | ZSOCK_POLLHUP | ZSOCK_POLLNVAL)) {
		return -ENOTCONN;
	}
	return mqtt_input(&client);
}

static int publish(const char *topic, const char *msg, bool retain)
{
	struct mqtt_publish_param p = {0};

	p.message.topic.topic.utf8 = (const uint8_t *)topic;
	p.message.topic.topic.size = strlen(topic);
	p.message.topic.qos = MQTT_QOS_0_AT_MOST_ONCE;
	p.message.payload.data = (uint8_t *)msg;
	p.message.payload.len = strlen(msg);
	p.message_id = next_msg_id++;
	p.retain_flag = retain ? 1 : 0;
	return mqtt_publish(&client, &p);
}

static int try_connect(void)
{
	int64_t until;
	int ret = client_setup();

	if (ret != 0) {
		return ret;
	}
	ret = mqtt_connect(&client);
	if (ret != 0) {
		return ret; /* 브로커에 TCP 연결 실패 */
	}
	until = k_uptime_get() + CONNACK_WAIT;
	while (!connected && k_uptime_get() < until) {
		if (pump_input(500) < 0) {
			break;
		}
	}
	if (!connected) {
		mqtt_abort(&client);
		return -ETIMEDOUT;
	}

	char st[48];

	snprintk(st, sizeof(st), "online %s", my_ip);
	(void)publish(TOPIC_STATUS, st, true);
	printk("[네트] MQTT 연결됨 (%s:%d, 토픽 %s)\n", CONFIG_BENCH_MQTT_BROKER,
	       CONFIG_BENCH_MQTT_PORT, TOPIC_LINE);
	return 0;
}

static void drop_connection(int why)
{
	printk("[네트] MQTT 끊김 (%d). 줄은 쌓아 두고 다시 붙음\n", why);
	mqtt_abort(&client);
	connected = false;
}

static void net_thread(void *a, void *b, void *c)
{
	static char cur[LINE_MAX];
	int64_t next_retry = 0;
	int last_err = 1;

	ARG_UNUSED(a);
	ARG_UNUSED(b);
	ARG_UNUSED(c);

	/* 주소를 못 받는 동안 10초마다 링크 상태를 찍어 원인을 가름 */
	for (int waited = 10; k_sem_take(&got_address, K_SECONDS(10)) != 0; waited += 10) {
		struct net_if *iface = net_if_get_default();
		struct net_linkaddr *ll = net_if_get_link_addr(iface);

		printk("[네트] %d초째 주소 없음: 랜선 링크 %s, MAC %02X:%02X:%02X:%02X:%02X:%02X%s\n",
		       waited, net_if_is_carrier_ok(iface) ? "붙음" : "안 붙음 (선·포트 확인)",
		       ll->addr[0], ll->addr[1], ll->addr[2], ll->addr[3], ll->addr[4], ll->addr[5],
		       net_if_is_carrier_ok(iface) ? ". 그 포트가 DHCP 를 안 주거나 응답이 늦음" : "");
	}

	for (;;) {
		int ret;

		if (!connected && k_uptime_get() >= next_retry) {
			ret = try_connect();
			if (ret != 0 && ret != last_err) {
				printk("[네트] 브로커 %s:%d 연결 실패 (%d). 5초마다 다시 시도\n",
				       CONFIG_BENCH_MQTT_BROKER, CONFIG_BENCH_MQTT_PORT, ret);
			}
			last_err = ret;
			next_retry = k_uptime_get() + RETRY_MS;
		}

		if (connected) {
			while (k_msgq_peek(&line_q, cur) == 0) {
				ret = publish(TOPIC_LINE, cur, false);
				if (ret != 0) {
					drop_connection(ret);
					break;
				}
				(void)k_msgq_get(&line_q, cur, K_NO_WAIT);
			}
		}

		if (connected) {
			ret = pump_input(100);
			if (ret == 0) {
				ret = mqtt_live(&client);
				if (ret == -EAGAIN) {
					ret = 0;
				}
			}
			if (ret != 0) {
				drop_connection(ret);
			}
		} else {
			k_msleep(100);
		}
	}
}

K_THREAD_STACK_DEFINE(net_stack, 4096);
static struct k_thread net_thread_data;

void bench_net_start(void)
{
	struct net_if *iface = net_if_get_default();

	if (iface == NULL) {
		printk("[네트] 네트워크 인터페이스 없음: MQTT 안 보냄\n");
		return;
	}
	net_mgmt_init_event_callback(&mgmt_cb, on_net_event, NET_EVENT_IPV4_ADDR_ADD);
	net_mgmt_add_event_callback(&mgmt_cb);
	net_dhcpv4_start(iface);
	printk("[네트] 랜선 연결 대기 + DHCP 요청 중 (주소 받으면 MQTT 로 보냄)\n");

	k_thread_create(&net_thread_data, net_stack, K_THREAD_STACK_SIZEOF(net_stack), net_thread,
			NULL, NULL, NULL, K_PRIO_PREEMPT(8), 0, K_NO_WAIT);
	k_thread_name_set(&net_thread_data, "bench_net");
}
```

## src/bench_net.h
```c
/* 이더넷(DHCP) + MQTT 로 측정 줄을 PC 브로커에 보냄 */
#ifndef BENCH_NET_H_
#define BENCH_NET_H_

/* DHCP 시작 + 전송 스레드 시작. main() 처음에 한 번 부름 */
void bench_net_start(void);

/* 시리얼에 찍는 줄과 같은 글을 MQTT 로 보낼 줄 대기열에 넣음 (줄바꿈 없이) */
void bench_net_send(const char *line);

#endif
```

## src/bme280.c
```c
/* Bosch BME280 드라이버 — bme280.h 참고 */
#include "bme280.h"

#define REG_CALIB_TP 0x88 /* 0x88..0xA1: T1..T3, P1..P9, (빈 칸), H1 */
#define REG_ID       0xD0
#define REG_CALIB_H  0xE1 /* 0xE1..0xE7: H2..H6 */
#define REG_CTRL_HUM 0xF2
#define REG_CTRL     0xF4
#define REG_CONFIG   0xF5
#define REG_DATA     0xF7 /* 0xF7..0xFE: 압력 3, 온도 3, 습도 2 바이트 */

#define ID_BME280 0x60
#define ID_BMP280 0x58

#define CTRL_HUM_X1 0x01 /* 습도 ×1 */
#define CONFIG_RUN  0x88 /* 쉬는 시간 500 ms(100), 필터 4(010) */
#define CTRL_RUN    0x57 /* 온도 ×2(010), 압력 ×16(101), normal 모드(11) */

static int rd(const i2c_bus_t *bus, uint8_t reg, uint8_t *d, size_t n)
{
	return bus->write_read(bus->ctx, BME280_ADDR, &reg, 1, d, n);
}

static int wr(const i2c_bus_t *bus, uint8_t reg, uint8_t v)
{
	const uint8_t w[2] = {reg, v};

	return bus->write(bus->ctx, BME280_ADDR, w, sizeof(w));
}

static uint16_t u16(const uint8_t *d)
{
	return (uint16_t)(d[0] | (d[1] << 8));
}

sens_err_t bme280_start(const i2c_bus_t *bus, bme280_cal_t *cal)
{
	uint8_t id = 0, a[26], e[7] = {0};

	if (rd(bus, REG_ID, &id, 1) != 0) {
		return SENS_E_BUS;
	}
	if (id != ID_BME280 && id != ID_BMP280) {
		return SENS_E_ID;
	}
	cal->has_hum = id == ID_BME280;
	if (rd(bus, REG_CALIB_TP, a, sizeof(a)) != 0 || (cal->has_hum && rd(bus, REG_CALIB_H, e, sizeof(e)) != 0)) {
		return SENS_E_BUS;
	}
	cal->t1 = u16(&a[0]);
	cal->t2 = (int16_t)u16(&a[2]);
	cal->t3 = (int16_t)u16(&a[4]);
	cal->p1 = u16(&a[6]);
	cal->p2 = (int16_t)u16(&a[8]);
	cal->p3 = (int16_t)u16(&a[10]);
	cal->p4 = (int16_t)u16(&a[12]);
	cal->p5 = (int16_t)u16(&a[14]);
	cal->p6 = (int16_t)u16(&a[16]);
	cal->p7 = (int16_t)u16(&a[18]);
	cal->p8 = (int16_t)u16(&a[20]);
	cal->p9 = (int16_t)u16(&a[22]);
	cal->h1 = a[25];
	cal->h2 = (int16_t)u16(&e[0]);
	cal->h3 = e[2];
	cal->h4 = (int16_t)(((int8_t)e[3] * 16) | (e[4] & 0x0F));
	cal->h5 = (int16_t)(((int8_t)e[5] * 16) | (e[4] >> 4));
	cal->h6 = (int8_t)e[6];

	/* 설정은 잠든 상태에서 써야 먹음. 습도 설정은 그 뒤 ctrl_meas 를 써야 반영됨 */
	if (wr(bus, REG_CTRL, 0x00) != 0 || (cal->has_hum && wr(bus, REG_CTRL_HUM, CTRL_HUM_X1) != 0) ||
	    wr(bus, REG_CONFIG, CONFIG_RUN) != 0 || wr(bus, REG_CTRL, CTRL_RUN) != 0) {
		return SENS_E_BUS;
	}
	return SENS_OK;
}

sens_err_t bme280_read(const i2c_bus_t *bus, const bme280_cal_t *cal, bme280_reading_t *out)
{
	uint8_t d[8];

	if (rd(bus, REG_DATA, d, sizeof(d)) != 0) {
		return SENS_E_BUS;
	}
	int32_t adc_p = ((int32_t)d[0] << 12) | ((int32_t)d[1] << 4) | (d[2] >> 4);
	int32_t adc_t = ((int32_t)d[3] << 12) | ((int32_t)d[4] << 4) | (d[5] >> 4);
	int32_t adc_h = ((int32_t)d[6] << 8) | d[7];

	if (adc_p == 0x80000 || adc_t == 0x80000) {
		return SENS_E_BUSY; /* 켜진 뒤 한 번도 안 잰 값 그대로 */
	}

	double v1 = (adc_t / 16384.0 - cal->t1 / 1024.0) * cal->t2;
	double v2 = (adc_t / 131072.0 - cal->t1 / 8192.0) * (adc_t / 131072.0 - cal->t1 / 8192.0) * cal->t3;
	double t_fine = v1 + v2;

	out->t_c = t_fine / 5120.0;

	v1 = t_fine / 2.0 - 64000.0;
	v2 = v1 * v1 * cal->p6 / 32768.0;
	v2 = v2 + v1 * cal->p5 * 2.0;
	v2 = v2 / 4.0 + cal->p4 * 65536.0;
	v1 = (cal->p3 * v1 * v1 / 524288.0 + cal->p2 * v1) / 524288.0;
	v1 = (1.0 + v1 / 32768.0) * cal->p1;
	if (v1 == 0.0) {
		return SENS_E_STATUS; /* 보정값이 비어 있음 */
	}
	double p = 1048576.0 - adc_p;

	p = (p - v2 / 4096.0) * 6250.0 / v1;
	v1 = cal->p9 * p * p / 2147483648.0;
	v2 = p * cal->p8 / 32768.0;
	out->p_pa = p + (v1 + v2 + cal->p7) / 16.0;

	out->rh = 0.0;
	if (cal->has_hum) {
		double h = t_fine - 76800.0;

		h = (adc_h - (cal->h4 * 64.0 + cal->h5 / 16384.0 * h)) *
		    (cal->h2 / 65536.0 * (1.0 + cal->h6 / 67108864.0 * h * (1.0 + cal->h3 / 67108864.0 * h)));
		h = h * (1.0 - cal->h1 * h / 524288.0);
		out->rh = h > 100.0 ? 100.0 : (h < 0.0 ? 0.0 : h);
	}
	/* 센서 범위: 300~1100 hPa, −40~85 °C */
	if (out->p_pa < 30000.0 || out->p_pa > 110000.0 || out->t_c < -40.0 || out->t_c > 85.0) {
		return SENS_E_RANGE;
	}
	return SENS_OK;
}
```

## src/bme280.h
```c
/* Bosch BME280 대기압 · 온도 · 습도 센서 (I2C 0x76) — 제품 드라이버와 같은 i2c_bus_t 를 씀
 *
 * 벤치에서는 정압 센서(ABP2)와 같은 I2C4 에 붙음. ABP2 는 게이지압(대기압 기준)이라,
 * 밀도 계산에 필요한 절대압 = 이 센서의 대기압 + ABP2 정압.
 * 온도 · 습도는 센서 둘레(관 밖) 공기 값임. 가스 온도는 관 속 DS18B20 이 잼.
 *
 * 센서가 스스로 0.5초마다 재도록(normal 모드) 한 번 걸어 두고, 읽을 때는 최근 값 8 바이트만 가져옴.
 *   대기압 ×16, 온도 ×2, 습도 ×1 겹쳐 재기 + 필터 4 (대기압 잔 흔들림 약 0.2 Pa)
 * 칩 번호 0x60 = BME280, 0x58 = BMP280(습도 없음, 나머지는 같음) 둘 다 받음.
 * 근거: Bosch BME280 데이터시트 rev 1.6 — 4.2.3 보정식(실수형), 5.4 레지스터.
 */
#pragma once

#include <stdbool.h>

#include "i2c_bus.h"

#define BME280_ADDR 0x76

typedef struct {
	uint16_t t1;
	int16_t t2, t3;
	uint16_t p1;
	int16_t p2, p3, p4, p5, p6, p7, p8, p9;
	uint8_t h1, h3;
	int16_t h2, h4, h5;
	int8_t h6;
	bool has_hum; /* BME280 이면 참, BMP280 이면 거짓 */
} bme280_cal_t;

typedef struct {
	double p_pa; /* 대기압 (Pa, 절대압) */
	double t_c;  /* 센서 둘레 온도 (°C) */
	double rh;   /* 상대 습도 (%). BMP280 이면 0 */
} bme280_reading_t;

/* 칩 번호 확인 → 보정값 읽기 → 연속 측정 걸기. 응답 없으면 SENS_E_BUS, 다른 칩이면 SENS_E_ID */
sens_err_t bme280_start(const i2c_bus_t *bus, bme280_cal_t *cal);

/* 최근 값. 아직 한 번도 안 쟀거나 센서가 꺼졌다 켜져 잠든 상태면 SENS_E_BUSY (다시 bme280_start 필요) */
sens_err_t bme280_read(const i2c_bus_t *bus, const bme280_cal_t *cal, bme280_reading_t *out);
```

## src/ds18b20.c
```c
/* DS18B20 드라이버 (1-Wire 를 GPIO 로 직접) — ds18b20.h 참고 */
#include <zephyr/kernel.h>
#include <zephyr/irq.h>

#include "ds18b20.h"

#define CMD_READ_ROM   0x33
#define CMD_SKIP_ROM   0xCC
#define CMD_CONVERT    0x44
#define CMD_READ_SPAD  0xBE

/* 선을 낮춤(0) / 놓음(1). open-drain 이라 1 은 풀업이 올림 */
static inline void line(const ds18b20_t *s, int v)
{
	gpio_pin_set_raw(s->port, s->pin, v);
}

static inline int sense(const ds18b20_t *s)
{
	gpio_port_value_t v = 0;

	(void)gpio_port_get_raw(s->port, &v);
	return (int)((v >> s->pin) & 1u);
}

/* 리셋: 480 µs 낮춤 → 놓고 70 µs 뒤 센서가 선을 낮추고 있으면(=0) 있음 */
static bool reset(const ds18b20_t *s)
{
	if (!sense(s)) {
		return false; /* 쉬는 선이 낮음: 풀업이 없거나 선이 GND 에 붙음 */
	}
	line(s, 0);
	k_busy_wait(480);
	unsigned int key = irq_lock();

	line(s, 1);
	k_busy_wait(70);
	int present = !sense(s);

	irq_unlock(key);
	k_busy_wait(410);
	return present && sense(s); /* 끝나면 선이 다시 올라와 있어야 함 */
}

static void write_bit(const ds18b20_t *s, int b)
{
	unsigned int key = irq_lock();

	line(s, 0);
	k_busy_wait(b ? 6 : 60);
	line(s, 1);
	k_busy_wait(b ? 64 : 10);
	irq_unlock(key);
}

static int read_bit(const ds18b20_t *s)
{
	unsigned int key = irq_lock();

	line(s, 0);
	k_busy_wait(3);
	line(s, 1);
	k_busy_wait(9);
	int b = sense(s);

	k_busy_wait(55);
	irq_unlock(key);
	return b;
}

static void write_byte(const ds18b20_t *s, uint8_t v)
{
	for (int i = 0; i < 8; i++) {
		write_bit(s, (v >> i) & 1);
	}
}

static uint8_t read_byte(const ds18b20_t *s)
{
	uint8_t v = 0;

	for (int i = 0; i < 8; i++) {
		v |= (uint8_t)(read_bit(s) << i);
	}
	return v;
}

/* Maxim CRC8: 다항식 x^8 + x^5 + x^4 + 1 (뒤집은 값 0x8C), 시작값 0 */
static uint8_t crc8(const uint8_t *d, size_t n)
{
	uint8_t c = 0;

	for (size_t i = 0; i < n; i++) {
		uint8_t in = d[i];

		for (int b = 0; b < 8; b++) {
			uint8_t mix = (c ^ in) & 1u;

			c >>= 1;
			if (mix) {
				c ^= 0x8C;
			}
			in >>= 1;
		}
	}
	return c;
}

static bool all_same(const uint8_t *d, size_t n, uint8_t v)
{
	for (size_t i = 0; i < n; i++) {
		if (d[i] != v) {
			return false;
		}
	}
	return true;
}

sens_err_t ds18b20_start(ds18b20_t *s, const struct device *port, gpio_pin_t pin, uint8_t rom[8])
{
	s->port = port;
	s->pin = pin;
	s->family = 0;
	if (!device_is_ready(port) ||
	    gpio_pin_configure(port, pin, GPIO_OUTPUT_HIGH | GPIO_OPEN_DRAIN | GPIO_PULL_UP) != 0) {
		return SENS_E_BUS;
	}
	k_busy_wait(500);
	if (!reset(s)) {
		return SENS_E_BUS;
	}
	write_byte(s, CMD_READ_ROM);
	for (int i = 0; i < 8; i++) {
		rom[i] = read_byte(s);
	}
	if (all_same(rom, 8, 0xFF) || all_same(rom, 8, 0x00)) {
		return SENS_E_BUS;
	}
	if (crc8(rom, 7) != rom[7]) {
		return SENS_E_STATUS; /* 센서가 둘 이상이면 주소가 섞여 CRC 가 틀림 */
	}
	s->family = rom[0];
	return SENS_OK;
}

sens_err_t ds18b20_convert(const ds18b20_t *s)
{
	if (!reset(s)) {
		return SENS_E_BUS;
	}
	write_byte(s, CMD_SKIP_ROM);
	write_byte(s, CMD_CONVERT);
	return SENS_OK;
}

sens_err_t ds18b20_read(const ds18b20_t *s, double *t_c)
{
	uint8_t d[9];

	if (!reset(s)) {
		return SENS_E_BUS;
	}
	write_byte(s, CMD_SKIP_ROM);
	write_byte(s, CMD_READ_SPAD);
	for (int i = 0; i < 9; i++) {
		d[i] = read_byte(s);
	}
	if (all_same(d, 9, 0xFF) || all_same(d, 9, 0x00)) {
		return SENS_E_BUS;
	}
	if (crc8(d, 8) != d[8]) {
		return SENS_E_STATUS;
	}
	int16_t raw = (int16_t)(d[0] | (d[1] << 8));

	*t_c = s->family == 0x10 ? raw / 2.0 : raw / 16.0;
	if (s->family != 0x10 && raw == 0x0550) {
		return SENS_STALE; /* 85.0 °C = 켜진 직후 기본값 */
	}
	return SENS_OK;
}
```

## src/ds18b20.h
```c
/* DS18B20 온도 센서 (1-Wire, 선 3개: 전원 · GND · 데이터) — 관 속 가스 온도용
 *
 * 데이터 선 하나를 GPIO 로 직접 흔들어 읽음 (open-drain, 풀업 4.7 kΩ 는 어댑터 보드에 있음).
 * 변환(12 비트)에 최대 750 ms 가 걸려서 "변환 시작" 과 "결과 읽기" 를 나눠 부름:
 *   1초마다  ds18b20_read() 로 지난번 변환 결과를 읽고 → ds18b20_convert() 로 다음 변환을 걺.
 * 버스에 센서가 하나뿐이라고 보고 주소 없이(Skip ROM) 말함.
 * 비트 하나(약 70 µs) 동안만 인터럽트를 막음. 한 번 읽는 데 약 8 ms.
 * 근거: Maxim DS18B20 데이터시트 (19-7487 Rev 6) — 타이밍 · 스크래치패드 · CRC.
 */
#pragma once

#include <zephyr/device.h>
#include <zephyr/drivers/gpio.h>

#include "i2c_bus.h" /* sens_err_t */

typedef struct {
	const struct device *port;
	gpio_pin_t pin;
	uint8_t family; /* ROM 첫 바이트: 0x28 = DS18B20, 0x22 = DS1822, 0x10 = DS18S20(눈금 0.5 °C) */
} ds18b20_t;

/* 핀 설정 + 센서 찾기. rom 에 8 바이트 주소를 채움. 응답 없으면 SENS_E_BUS, CRC 틀리면 SENS_E_STATUS */
sens_err_t ds18b20_start(ds18b20_t *s, const struct device *port, gpio_pin_t pin, uint8_t rom[8]);

/* 온도 변환 시작 (끝나기까지 최대 750 ms) */
sens_err_t ds18b20_convert(const ds18b20_t *s);

/* 지난 변환 결과 (°C). 응답 없으면 SENS_E_BUS, CRC 틀리면 SENS_E_STATUS,
 * 켜진 직후 값(85 °C) 그대로면 SENS_STALE (변환이 안 된 것. 센서 전원이 잠깐 끊겼을 때도 이 값) */
sens_err_t ds18b20_read(const ds18b20_t *s, double *t_c);
```

## src/sdp810.c
```c
/* Sensirion SDP810-500Pa 드라이버 — sdp810.h 참고 */
#include "sdp810.h"

#define CMD_START_AVG 0x3615 /* 연속 측정, 차압 온도 보정, 읽을 때까지 평균 */
#define CMD_STOP      0x3FF9 /* 연속 측정 멈춤 (멈춘 뒤 0.5 ms 이상 기다려야 다음 명령) */

/* 데이터시트 CRC: 다항식 0x31, 시작값 0xFF, 2 바이트마다 하나 */
static uint8_t crc8(const uint8_t *d, size_t n)
{
	uint8_t c = 0xFF;

	for (size_t i = 0; i < n; i++) {
		c ^= d[i];
		for (int b = 0; b < 8; b++) {
			c = (c & 0x80) ? (uint8_t)((c << 1) ^ 0x31) : (uint8_t)(c << 1);
		}
	}
	return c;
}

static int cmd(const i2c_bus_t *bus, uint16_t code)
{
	const uint8_t w[2] = {(uint8_t)(code >> 8), (uint8_t)code};

	return bus->write(bus->ctx, SDP810_ADDR, w, sizeof(w));
}

sens_err_t sdp810_start(const i2c_bus_t *bus)
{
	(void)cmd(bus, CMD_STOP); /* 이미 멈춰 있으면 응답이 없을 수 있어 결과는 안 봄 */
	bus->delay_ms(bus->ctx, 2);
	if (cmd(bus, CMD_START_AVG) != 0) {
		return SENS_E_BUS;
	}
	bus->delay_ms(bus->ctx, 10); /* 첫 값이 나오기까지 몇 ms */
	return SENS_OK;
}

sens_err_t sdp810_read(const i2c_bus_t *bus, sdp810_reading_t *out)
{
	uint8_t r[9];

	if (bus->read(bus->ctx, SDP810_ADDR, r, sizeof(r)) != 0) {
		return SENS_E_BUS;
	}
	for (int i = 0; i < 9; i += 3) {
		if (crc8(&r[i], 2) != r[i + 2]) {
			return SENS_E_STATUS;
		}
	}
	int16_t dp = (int16_t)((r[0] << 8) | r[1]);
	int16_t t = (int16_t)((r[3] << 8) | r[4]);
	uint16_t sf = (uint16_t)((r[6] << 8) | r[7]);

	if (sf == 0) {
		return SENS_E_STATUS;
	}
	out->scale = sf;
	out->p_pa = (double)dp / sf;
	out->t_c = (double)t / 200.0;
	return (dp == INT16_MAX || dp == INT16_MIN) ? SENS_E_RANGE : SENS_OK;
}
```

## src/sdp810.h
```c
/* Sensirion SDP810-500Pa 차압 센서 (I2C 0x25) — 제품 드라이버와 같은 i2c_bus_t 를 씀
 *
 * 연속 측정(0x3615, 읽을 때까지 평균)을 한 번 걸어 두고, 읽을 때마다 그 사이 평균을 받음.
 * 9 바이트 = 차압 · 온도 · 배율이 2 바이트 + CRC 씩. 차압 = 값 / 배율(500 Pa 형은 60), 온도 = 값 / 200.
 * 근거: Sensirion SDP8xx-Digital 데이터시트 v1.1 (2019-04) 5장 · 6장.
 */
#pragma once

#include "i2c_bus.h"

#define SDP810_ADDR 0x25

typedef struct {
	double p_pa;      /* 차압 (Pa), + 포트가 높으면 양수 */
	double t_c;       /* 센서 온도 (°C) */
	uint16_t scale;   /* 센서가 알려 준 배율 (500 Pa 형 = 60) */
} sdp810_reading_t;

/* 혹시 돌던 측정을 멈추고 연속 측정을 새로 걺. 응답 없으면 SENS_E_BUS */
sens_err_t sdp810_start(const i2c_bus_t *bus);

/* 마지막 읽기 이후 평균값. CRC 틀리면 SENS_E_STATUS, 끝값(포화)이면 SENS_E_RANGE(값은 채움) */
sens_err_t sdp810_read(const i2c_bus_t *bus, sdp810_reading_t *out);
```
